## conf/layer.conf
```bitbake
BBPATH .= ":${LAYERDIR}"
BBFILES += "${LAYERDIR}/recipes-*/*/*.bb"

BBFILE_COLLECTIONS += "golang"
BBFILE_PATTERN_golang = "^${LAYERDIR}/"
BBFILE_PRIORITY_golang = "5"

LAYERVERSION_golang = "1"

LAYERDEPENDS_golang = "core"
```
